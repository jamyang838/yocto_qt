## conf/bblayers.conf
```bitbake
# POKY_BBLAYERS_CONF_VERSION is increased each time build/conf/bblayers.conf
# changes incompatibly
POKY_BBLAYERS_CONF_VERSION = "2"

BBPATH = "${TOPDIR}"
BBFILES ?= ""

BBLAYERS ?= " \
  /home/yang/source/poky/meta \
  /home/yang/source/poky/meta-poky \
  /home/yang/source/poky/meta-yocto-bsp \
  /home/yang/source/meta-raspberrypi \
  /home/yang/source/meta-openembedded/meta-oe \
  /home/yang/source/meta-qt5 \
  /home/yang/source/poky/build/meta-laser \
  /home/yang/source/meta-openembedded/meta-python \
  /home/yang/source/meta-openembedded/meta-networking \
  "
```

## meta-laser/conf/distro/example-distro.conf
```bitbake
MAINTAINER = "yang <jamyang838@icloud.com>"

require conf/distro/poky.conf

DISTRO = "example-distro"
DISTRO_NAME = "example distro"
DISTRO_VERSION = "1.0"
DISTRO_CODENAME = "example"
SDK_VENDER = "-exampledistro"
SDK_VERSION = "sdkversion"

#set hostname
hostname_pn-base-files = "m2laser"

#Replace sysv with systemd
DISTRO_FEATURES += "systemd"
VIRTUAL-RUNTIME_init_manager = "systemd"
DISTRO_FEATURES_remove += "sysvinit"
VIRTUAL-RUNTIME_initscripts = "systemd-compat-units"
DISTRO_FEATURES_BACKFILL_CONSIDERED += "sysvinit"

#remove unneeded features
DISTRO_FEATURES += "opengl"
DISTRO_FEATURES_remove += "bluetooth ext2 irda pcmcia 3g nfc x11"
```

## meta-laser/conf/layer.conf
```bitbake
# We have a conf and classes directory, add to BBPATH
BBPATH .= ":${LAYERDIR}"

# We have recipes-* directories, add to BBFILES
BBFILES += "${LAYERDIR}/recipes-*/*/*.bb \
            ${LAYERDIR}/recipes-*/*/*.bbappend"

BBFILE_COLLECTIONS += "meta-laser"
BBFILE_PATTERN_meta-laser = "^${LAYERDIR}/"
BBFILE_PRIORITY_meta-laser = "6"

LAYERSERIES_COMPAT_laser = "sumo"
```
